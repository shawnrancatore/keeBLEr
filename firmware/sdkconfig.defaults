## firmware/sdkconfig.defaults
```kconfig
# SPDX-License-Identifier: MIT
# Keebler sdkconfig defaults
# Target: ESP32-S3

CONFIG_IDF_TARGET="esp32s3"

# ---------- TinyUSB HID device ----------

CONFIG_TINYUSB_HID_COUNT=1
CONFIG_TINYUSB_DESC_USE_ESPRESSIF_VID=n
CONFIG_TINYUSB_DESC_CUSTOM_VID=0x1209
CONFIG_TINYUSB_DESC_USE_DEFAULT_PID=n
CONFIG_TINYUSB_DESC_CUSTOM_PID=0x4B42
CONFIG_TINYUSB_DESC_MANUFACTURER_STRING="Keebler"
CONFIG_TINYUSB_DESC_PRODUCT_STRING="Keebler HID Bridge"
CONFIG_TINYUSB_DESC_SERIAL_STRING="000001"

# ---------- Console / USB PHY handoff ----------
# Primary console on UART0.  The secondary USB-Serial-JTAG console MUST stay
# enabled: the ROM bootloader initialises USB-Serial-JTAG during early boot
# and TinyUSB's usb_new_phy() relies on the Serial-JTAG driver being present
# to cleanly transition the USB PHY from Serial-JTAG to OTG mode.

CONFIG_ESP_CONSOLE_UART_DEFAULT=y
CONFIG_ESP_CONSOLE_SECONDARY_USB_SERIAL_JTAG=y

# ---------- Bluetooth (NimBLE, peripheral only) ----------

CONFIG_BT_ENABLED=y
CONFIG_BT_NIMBLE_ENABLED=y
CONFIG_BT_NIMBLE_MAX_CONNECTIONS=1
CONFIG_BT_NIMBLE_ROLE_PERIPHERAL=y
CONFIG_BT_NIMBLE_ROLE_CENTRAL=n
CONFIG_BT_NIMBLE_ROLE_OBSERVER=n
CONFIG_BT_NIMBLE_ROLE_BROADCASTER=n
CONFIG_BT_NIMBLE_NVS_PERSIST=y

# ---------- Partition table ----------

CONFIG_PARTITION_TABLE_SINGLE_APP=y

# ---------- Stack sizes ----------

CONFIG_ESP_MAIN_TASK_STACK_SIZE=4096
CONFIG_BT_NIMBLE_HOST_TASK_STACK_SIZE=6144
```
